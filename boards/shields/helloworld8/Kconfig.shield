## boards/shields/helloworld8/Kconfig.shield
```kconfig
config SHIELD_HELLOWORLD8_LEFT
    def_bool $(shields_list_contains,helloworld8_left)

config SHIELD_HELLOWORLD8_RIGHT
    def_bool $(shields_list_contains,helloworld8_right)
```

## config/Kconfig.defconfig
```kconfig
if SHIELD_HELLOWORLD8_LEFT

config ZMK_KEYBOARD_NAME
    default "HelloWorld8"

config ZMK_SPLIT_ROLE_CENTRAL
    default y

endif

if SHIELD_HELLOWORLD8_LEFT || SHIELD_HELLOWORLD8_RIGHT

config ZMK_SPLIT
    default y

endif
```
